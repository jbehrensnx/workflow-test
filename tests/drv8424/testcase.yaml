## tests/drv8424/testcase.yaml
```yaml
# Copyright (c) 2025 Navimatix GmbH
# SPDX-License-Identifier: Apache-2.0

tests:
  drivers.stepper.drv8424:
    tags:
      - drivers
      - stepper
      - api
      - drv8424
    platform_allow:
      - native_sim
```
